## CMakeLists.txt
```
cmake_minimum_required(VERSION 3.20.0)
find_package(Zephyr REQUIRED HINTS $ENV{ZEPHYR_BASE})

project(nrf_virtual_mouse)

target_sources(app PRIVATE
    src/main.c
    src/imu.c
    src/ble_raw_data.c
    src/imu_mouse.c
    src/ble_central.c
    src/ble_hid.c
)
```

## prj.conf
```kconfig
CONFIG_GPIO=y

# Bluetooth
CONFIG_BT=y
CONFIG_BT_PERIPHERAL=y
CONFIG_BT_DEVICE_NAME="Virtual Mouse"
CONFIG_BT_DEVICE_APPEARANCE=962

# Central role — connects out to an ESP32 peripheral (ENABLE_NRF53_AS_CENTRAL).
# Always built in; dormant (no scanning) unless the C flag is enabled.
CONFIG_BT_CENTRAL=y
CONFIG_BT_GATT_CLIENT=y

# HID over GATT (HOGP)
CONFIG_BT_HIDS=y
CONFIG_BT_CONN_CTX=y

# Device Information Service
CONFIG_BT_DIS=y
CONFIG_BT_DIS_PNP=y

# Security and bonding
CONFIG_BT_SMP=y
CONFIG_BT_SETTINGS=y
CONFIG_FLASH=y
CONFIG_FLASH_PAGE_LAYOUT=y
CONFIG_FLASH_MAP=y
CONFIG_NVS=y
CONFIG_SETTINGS=y

# IMU — I2C bus only; LSM6DSO is accessed directly in imu.c (no sensor driver)
CONFIG_I2C=y

# GATT pool — HIDS needs ~6 chrc slots; default is 5, so it always exhausted
CONFIG_BT_GATT_CHRC_POOL_SIZE=10

# BLE TX buffers — default (3) fills up quickly when notifying at high IMU rates.
# More buffers lets the stack queue more packets, reducing dropped notifications.
CONFIG_BT_BUF_ACL_TX_COUNT=20

# Extended advertising — two advertising sets, one per BLE identity:
#   Identity 0 "Virtual Mouse" — HID, bonds with OS.
#   Identity 1 "VM-Raw"        — raw IMU, connects to Python script.
# Identity 1's advertising set runs independently alongside identity 0's
# connection; no re-advertising problem.
# Requires CONFIG_BT_EXT_ADV=y + CONFIG_BT_EXT_ADV_MAX_ADV_SET=2 in BOTH
# app core (here) and network core (child_image/hci_ipc.conf).
CONFIG_BT_EXT_ADV=y
CONFIG_BT_EXT_ADV_MAX_ADV_SET=2
CONFIG_BT_ID_MAX=2

# EATT — macOS uses Enhanced ATT for larger MTU; batch=3 needs 48-byte payload.
CONFIG_BT_L2CAP_DYNAMIC_CHANNEL=y
CONFIG_BT_L2CAP_ECRED=y
CONFIG_BT_EATT=y
CONFIG_BT_L2CAP_TX_MTU=100

# Four conn slots: HID connection + raw connection + ESP32 central connection
# + 1 pending-adv pre-alloc headroom (Zephyr pre-allocates a bt_conn when
# starting connectable adv). Must match CONFIG_BT_MAX_CONN in
# child_image/hci_ipc.conf (net core) so the SDC allocates matching link slots.
CONFIG_BT_MAX_CONN=4

# FPU — required for float math in imu_mouse.c across thread contexts
CONFIG_FPU=y
CONFIG_FPU_SHARING=y

# Logging
CONFIG_LOG=y
CONFIG_BT_LOG_LEVEL_WRN=y
CONFIG_LOG_PRINTK=n

# Float support in printk / LOG (required for %f in debug output)
CONFIG_CBPRINTF_FP_SUPPORT=y
```

## boards/nrf5340dk_nrf5340_cpuapp.overlay
```dts
/*
 * Board overlay for nRF5340-DK
 *
 * Sets I2C to 400 kHz (fast-mode) for the LSM6DSO on the arduino_i2c
 * header (QWIIC-compatible, SDA=D14/P1.02, SCL=D15/P1.03).
 *
 * The LSM6DSO is NOT bound to the Zephyr sensor driver here — imu.c
 * accesses its registers directly via the I2C bus to use the on-chip
 * FIFO and hardware timestamps.
 *
 * UART0 baud rate raised to 460800 to sustain 208 Hz CSV output.
 */

&arduino_i2c {
	status = "okay";
	clock-frequency = <400000>;
};

&uart0 {
	current-speed = <460800>;
};
```

## src/main.c
```c
/* app_config.h contains all key compile time configuration parameters*/
#include "app_config.h"
#include <zephyr/bluetooth/bluetooth.h>
#include <zephyr/bluetooth/conn.h>
#include <zephyr/kernel.h>
#include <zephyr/logging/log.h>
#include <zephyr/settings/settings.h>

#include "ble_central.h"
#include "ble_hid.h"
#include "ble_raw_data.h"
#include "imu.h"

LOG_MODULE_REGISTER(app, LOG_LEVEL_INF);

/* ============================================================
 * Connection callbacks — generic, identity-agnostic logging only.
 * Each BLE module (ble_hid.c, ble_raw_data.c, ble_central.c) registers its
 * own BT_CONN_CB_DEFINE for identity-specific behavior; Zephyr fans out
 * connection events to every registered callback struct.
 * ============================================================ */

static void connected(struct bt_conn* conn, uint8_t err) {
    if (err) {
        return;
    }
    struct bt_conn_info info;
    bt_conn_get_info(conn, &info);
    DBG_PRINTK("CONNECTED: id=%u role=%u interval=%u (%.2f ms)\n",
               info.id, info.role, info.le.interval, (float)info.le.interval * 1.25f);
}

static void disconnected(struct bt_conn* conn, uint8_t reason) {
    struct bt_conn_info info;
    bt_conn_get_info(conn, &info);
    DBG_PRINTK("DISCONNECTED: id=%u role=%u reason=%u\n", info.id, info.role, reason);
}

static void security_changed(struct bt_conn* conn, bt_security_t level,
                             enum bt_security_err err) {
    if (err) {
        DBG_PRINTK("SECURITY_FAILED: err=%d\n", err);
        return;
    }
    DBG_PRINTK("SECURITY_OK: level=%d\n", level);
}

static void le_param_updated(struct bt_conn* conn, uint16_t interval,
                             uint16_t latency, uint16_t timeout) {
    struct bt_conn_info info;
    bt_conn_get_info(conn, &info);
    DBG_PRINTK("CONN_PARAMS:id=%u interval=%u (%.2f ms) latency=%u timeout=%u\n",
               info.id, interval, (float)interval * 1.25f, latency, timeout);
}

BT_CONN_CB_DEFINE(conn_callbacks) = {
    .connected = connected,
    .disconnected = disconnected,
    .security_changed = security_changed,
    .le_param_updated = le_param_updated,
};

static void auth_cancel(struct bt_conn* conn) {
    ARG_UNUSED(conn);
}
static struct bt_conn_auth_cb auth_cb = {.cancel = auth_cancel};

static void pairing_failed(struct bt_conn* conn, enum bt_security_err reason) {
    ARG_UNUSED(reason);
    bt_conn_disconnect(conn, BT_HCI_ERR_AUTH_FAIL);
}
static struct bt_conn_auth_info_cb auth_info_cb = {.pairing_failed = pairing_failed};

/* ============================================================
 * Output mode control
 * ============================================================ */

static void apply_output_mode(int mode) {
    imu_set_uart_raw(mode == 0);

#ifdef ENABLE_BLE_HID
    ble_hid_set_active(mode == 1 || mode == 3);
#endif
#ifdef ENABLE_BLE_RAW_DATA
    ble_raw_data_set_enabled(mode == 2 || mode == 3);
#endif
}

/* ============================================================
 * Entry point
 * ============================================================ */

int main(void) {
    imu_set_mode_change_cb(apply_output_mode);

#if defined(ENABLE_BLE_HID) || defined(ENABLE_BLE_RAW_DATA) || defined(ENABLE_NRF53_AS_CENTRAL)
    bt_conn_auth_cb_register(&auth_cb);
    bt_conn_auth_info_cb_register(&auth_info_cb);
    bt_enable(NULL);
    settings_load();

#ifdef ENABLE_BLE_HID
    ble_hid_init();
#endif
#ifdef ENABLE_BLE_RAW_DATA
    ble_raw_data_init();
#endif
#ifdef ENABLE_NRF53_AS_CENTRAL
    ble_central_init();
#endif

    apply_output_mode(DEFAULT_OUTPUT_MODE);
#else /* no BLE features compiled in — UART-only build */
    apply_output_mode(DEFAULT_OUTPUT_MODE);
#endif

    return 0;
}
```

## src/app_config.h
```c
/*
 * app_config.h — Project-wide tunable parameters
 */

#ifndef APP_CONFIG_H
#define APP_CONFIG_H

#include <zephyr/sys/printk.h>

/* ============================================================
 * Compile-time feature guards.
 * Comment out a define to strip that feature from the build entirely.
 * If neither is defined the BLE stack is not initialised at all.
 *
 *   ENABLE_BLE_HID       — HID mouse profile (identity 0, "Virtual Mouse")
 *                          macOS and Windows pair with this as a standard mouse.
 *   ENABLE_BLE_RAW_DATA  — Raw IMU GATT notify service (identity 1, "VM-Raw").
 *
 *   ENABLE_NRF53_AS_CENTRAL — nRF53 also acts as a BLE Central, connecting out
 *                          to an ESP32 peripheral and mapping its 4 ASCII
 *                          commands ("cmd1".."cmd4") to LED1-LED4. Disables
 *                          the heartbeat blink (frees led0 for cmd1).
 * ============================================================ */
#define ENABLE_BLE_HID
#define ENABLE_BLE_RAW_DATA
#define ENABLE_NRF53_AS_CENTRAL

/* ============================================================
 * Output mode — sets the active mode at boot.
 * Can be changed at runtime with the UART command "MODE:N".
 *
 *   0 — UART  : IMU → CSV on UART. No BLE activity.
 *   1 — HID   : BLE HID mouse only.          Requires ENABLE_BLE_HID.
 *   2 — Raw   : BLE raw IMU stream only.      Requires ENABLE_BLE_RAW_DATA.
 *   3 — Both  : HID mouse + raw IMU stream.   Requires both.
 * ============================================================ */
#define DEFAULT_OUTPUT_MODE 3

/* ============================================================
 * ENABLE_UART_DEBUGGING — compile-time only (independent of mode).
 * Enables [cal]/[gyro]/[imu] prints, FIFO overrun warnings, and
 * rate/mode status echoes.  Comment out for a quiet build.
 * ============================================================ */
// #define ENABLE_UART_DEBUGGING

#ifdef ENABLE_UART_DEBUGGING
#define DBG_PRINTK(...) printk(__VA_ARGS__)
#else
#define DBG_PRINTK(...) \
    do {                \
    } while (0)
#endif

/* ============================================================
 * Board mounting orientation.
 * Define exactly one to hardcode the sensor→world remap — required, there
 * is no runtime auto-detection.
 *
 *   IMU_MOUNT_Z_UP    — board flat, sensor chip face-up
 *   IMU_MOUNT_Y_DOWN  — board rotated 90° around X-axis, Y-axis pointing down
 * ============================================================ */
// #define IMU_MOUNT_Z_UP
#define IMU_MOUNT_Y_DOWN

/* ============================================================
 * IMU sample rate — set IMU_RATE_IDX only; IMU_ODR_HZ is derived.
 * ============================================================ */
#define IMU_RATE_IDX 2

/* Derived from IMU_RATE_IDX — do not edit */
#if IMU_RATE_IDX == 0
#define IMU_ODR_HZ 13 /* 12.5 Hz hardware rate; rounded for integer math */
#elif IMU_RATE_IDX == 1
#define IMU_ODR_HZ 26
#elif IMU_RATE_IDX == 2
#define IMU_ODR_HZ 52
#elif IMU_RATE_IDX == 3
#define IMU_ODR_HZ 104
#elif IMU_RATE_IDX == 4
#define IMU_ODR_HZ 208
#else
#error "IMU_RATE_IDX must be 0–4"
#endif

/* ============================================================
 * Hardware constants — do not change without updating sensor config
 * ============================================================ */
#define IMU_GYRO_SCALE      57.143f  /* ±500 dps: 17.5 mdps/LSB → 1 dps = 57.14 LSB */
#define IMU_ACCEL_SCALE     16384.0f /* ±2 g: 0.061 mg/LSB */
#define IMU_TS_UNIT_S       25e-6f   /* seconds per hardware timestamp tick */
#define IMU_MIN_GRAVITY_LSB 8000.0f  /* reject calibration if |accel| < this in LSB */

/* ============================================================
 * Calibration timing
 * Phase 1 (settle): discard samples while sensor output stabilises.
 * Phase 2 (collect): accumulate samples to compute gyro bias + gravity.
 * ============================================================ */
#define IMU_CAL_SETTLE_S     3 // 3 second settling
#define IMU_CAL_COLLECT_S    3 // 3 seconds profiling noise/drift
#define IMU_CAL_SKIP_SAMPLES (IMU_ODR_HZ * IMU_CAL_SETTLE_S)
#define IMU_CAL_SAMPLES      (IMU_ODR_HZ * IMU_CAL_COLLECT_S)

/* ============================================================
 * Madgwick AHRS filter
 * ============================================================ */
#define IMU_MADGWICK_BETA   0.04f /* larger = faster convergence, more accel noise */
#define IMU_ACCEL_LPF_ALPHA 0.2f  /* EMA weight for new accel sample (0–1) */

/* ============================================================
 * dt (inter-sample period) derivation
 * ============================================================ */
#define IMU_NOMINAL_DT   (1.0f / (float)IMU_ODR_HZ)
#define IMU_MIN_DT       0.005f /* clamp outliers below this (seconds) */
#define IMU_MAX_DT       0.1f   /* clamp outliers above this (seconds) */
#define IMU_DT_ALPHA_NEW 0.2f   /* EMA weight for newly measured dt */
#define IMU_DT_ALPHA_OLD 0.8f   /* EMA weight for previous smoothed dt */

/* ============================================================
 * Mouse feel — adjust these without reflashing algorithm code
 * ============================================================ */
#define MOUSE_SENSITIVITY_X 50.0f /* pixels per degree of yaw */
#define MOUSE_SENSITIVITY_Y 50.0f /* pixels per degree of pitch */
#define MOUSE_DEADZONE_X    0.1f  /* degrees — motion below this is ignored */
#define MOUSE_DEADZONE_Y    0.1f  /* degrees */
#define MOUSE_SMOOTH_TAU    0.06f /* EMA time constant for output smoothing (seconds) */

#endif /* APP_CONFIG_H */
```

## src/ble_central.c
```c
/*
 * ble_central.c — nRF53 as BLE Central, connected to an ESP32 peripheral.
 * For demo purposes primarily, to show multi-role BLE works with other functionality.
 */

#include "app_config.h"

#ifdef ENABLE_NRF53_AS_CENTRAL
#include "ble_central.h"
#include <string.h>
#include <zephyr/bluetooth/bluetooth.h>
#include <zephyr/bluetooth/conn.h>
#include <zephyr/bluetooth/gatt.h>
#include <zephyr/bluetooth/uuid.h>
#include <zephyr/drivers/gpio.h>
#include <zephyr/kernel.h>
#include <zephyr/logging/log.h>
#include <zephyr/sys/printk.h>

LOG_MODULE_REGISTER(ble_central, LOG_LEVEL_INF);

/* ============================================================
 * Forward declarations
 * ============================================================ */

static void start_scan(void);

/* ============================================================
 * ESP32 peer — service / characteristic UUIDs and command set
 * ============================================================ */

#define BT_UUID_ESP32_SVC_VAL \
    BT_UUID_128_ENCODE(0x4fafc201, 0x1fb5, 0x459e, 0x8fcc, 0xc5c9c331914bULL)
#define BT_UUID_ESP32_CHRC_VAL \
    BT_UUID_128_ENCODE(0xbeb5483e, 0x36e1, 0x4688, 0xb7f5, 0xea07361b26a8ULL)

static struct bt_uuid_128 esp32_svc_uuid = BT_UUID_INIT_128(BT_UUID_ESP32_SVC_VAL);
static struct bt_uuid_128 esp32_chrc_uuid = BT_UUID_INIT_128(BT_UUID_ESP32_CHRC_VAL);

static const char* const commands[] = {"cmd1", "cmd2", "cmd3", "cmd4"};

/* Silkscreen LED1-LED4 == devicetree aliases led0-led3. */
static const struct gpio_dt_spec cmd_leds[] = {
    GPIO_DT_SPEC_GET(DT_ALIAS(led0), gpios),
    GPIO_DT_SPEC_GET(DT_ALIAS(led1), gpios),
    GPIO_DT_SPEC_GET(DT_ALIAS(led2), gpios),
    GPIO_DT_SPEC_GET(DT_ALIAS(led3), gpios),
};

BUILD_ASSERT(ARRAY_SIZE(cmd_leds) == ARRAY_SIZE(commands),
             "one LED per command");

static void handle_command(const uint8_t* data, uint16_t len) {
    for (size_t i = 0; i < ARRAY_SIZE(commands); i++) {
        size_t cmd_len = strlen(commands[i]);
        if (len == cmd_len && memcmp(data, commands[i], cmd_len) == 0) {
            int state = gpio_pin_toggle_dt(&cmd_leds[i]);
            ARG_UNUSED(state);
            DBG_PRINTK("CENTRAL_CMD: %s -> LED%u %s\n", commands[i], (unsigned)(i + 1),
                       state == 0 ? "toggled" : "toggle failed");
            return;
        }
    }
    DBG_PRINTK("CENTRAL_CMD: unrecognized (%u bytes)\n", len);
}

/* ============================================================
 * GATT discovery + subscribe
 * ============================================================ */

static struct bt_gatt_discover_params  discover_params;
static struct bt_gatt_subscribe_params subscribe_params;

static uint8_t notify_func(struct bt_conn*                  conn,
                           struct bt_gatt_subscribe_params* params,
                           const void* data, uint16_t length) {
    ARG_UNUSED(conn);

    if (!data) {
        DBG_PRINTK("CENTRAL: unsubscribed\n");
        params->value_handle = 0U;
        return BT_GATT_ITER_STOP;
    }

    handle_command((const uint8_t*)data, length);
    return BT_GATT_ITER_CONTINUE;
}

static uint8_t discover_func(struct bt_conn*                 conn,
                             const struct bt_gatt_attr*      attr,
                             struct bt_gatt_discover_params* params) {
    int err;

    if (!attr) {
        DBG_PRINTK("CENTRAL: discovery failed/complete\n");
        (void)memset(params, 0, sizeof(*params));
        return BT_GATT_ITER_STOP;
    }

    if (!bt_uuid_cmp(discover_params.uuid, &esp32_svc_uuid.uuid)) {
        discover_params.uuid = &esp32_chrc_uuid.uuid;
        discover_params.start_handle = attr->handle + 1;
        discover_params.type = BT_GATT_DISCOVER_CHARACTERISTIC;

        err = bt_gatt_discover(conn, &discover_params);
        if (err) {
            DBG_PRINTK("CENTRAL: characteristic discover failed (%d)\n", err);
        }
    } else if (!bt_uuid_cmp(discover_params.uuid, &esp32_chrc_uuid.uuid)) {
        subscribe_params.value_handle = bt_gatt_attr_value_handle(attr);

        discover_params.uuid = BT_UUID_GATT_CCC;
        discover_params.start_handle = attr->handle + 2;
        discover_params.type = BT_GATT_DISCOVER_DESCRIPTOR;

        err = bt_gatt_discover(conn, &discover_params);
        if (err) {
            DBG_PRINTK("CENTRAL: CCC discover failed (%d)\n", err);
        }
    } else {
        subscribe_params.notify = notify_func;
        subscribe_params.value = BT_GATT_CCC_NOTIFY;
        subscribe_params.ccc_handle = attr->handle;

        err = bt_gatt_subscribe(conn, &subscribe_params);
        if (err && err != -EALREADY) {
            DBG_PRINTK("CENTRAL: subscribe failed (%d)\n", err);
        } else {
            DBG_PRINTK("CENTRAL: subscribed\n");
        }
        return BT_GATT_ITER_STOP;
    }

    return BT_GATT_ITER_STOP;
}

static void start_discovery(struct bt_conn* conn) {
    discover_params.uuid = &esp32_svc_uuid.uuid;
    discover_params.func = discover_func;
    discover_params.start_handle = BT_ATT_FIRST_ATTRIBUTE_HANDLE;
    discover_params.end_handle = BT_ATT_LAST_ATTRIBUTE_HANDLE;
    discover_params.type = BT_GATT_DISCOVER_PRIMARY;

    int err = bt_gatt_discover(conn, &discover_params);
    if (err) {
        DBG_PRINTK("CENTRAL: service discover failed (%d)\n", err);
    }
}

/* ============================================================
 * Scan + connect
 * ============================================================ */

static struct bt_conn* esp32_conn;

static bool uuid_match_cb(struct bt_data* data, void* user_data) {
    bool* found = user_data;

    if (data->type != BT_DATA_UUID128_SOME && data->type != BT_DATA_UUID128_ALL) {
        return true; /* keep parsing */
    }

    for (uint16_t i = 0; i + 16 <= data->data_len; i += 16) {
        if (memcmp(&data->data[i], esp32_svc_uuid.val, 16) == 0) {
            *found = true;
            return false; /* stop parsing */
        }
    }
    return true;
}

static void device_found(const bt_addr_le_t* addr, int8_t rssi, uint8_t type,
                         struct net_buf_simple* ad) {
    ARG_UNUSED(rssi);

    if (esp32_conn) {
        return;
    }
    if (type != BT_GAP_ADV_TYPE_ADV_IND && type != BT_GAP_ADV_TYPE_ADV_DIRECT_IND) {
        return;
    }

    bool found = false;
    bt_data_parse(ad, uuid_match_cb, &found);
    if (!found) {
        return;
    }

    char addr_str[BT_ADDR_LE_STR_LEN];
    bt_addr_le_to_str(addr, addr_str, sizeof(addr_str));
    DBG_PRINTK("CENTRAL: ESP32 found (%s), connecting\n", addr_str);

    if (bt_le_scan_stop()) {
        return;
    }

    int err = bt_conn_le_create(addr, BT_CONN_LE_CREATE_CONN,
                                BT_LE_CONN_PARAM_DEFAULT, &esp32_conn);
    if (err) {
        DBG_PRINTK("CENTRAL: create conn failed (%d)\n", err);
        start_scan();
    }
}

static void start_scan(void) {
    struct bt_le_scan_param scan_param = {
        .type = BT_LE_SCAN_TYPE_ACTIVE,
        .options = BT_LE_SCAN_OPT_NONE,
        .interval = BT_GAP_SCAN_FAST_INTERVAL,
        .window = BT_GAP_SCAN_FAST_WINDOW,
    };

    int err = bt_le_scan_start(&scan_param, device_found);
    if (err == 0) {
        DBG_PRINTK("CENTRAL: scanning for ESP32\n");
    } else if (err != -EALREADY) {
        DBG_PRINTK("CENTRAL: scan start failed (%d)\n", err);
    }
}

/* ============================================================
 * Connection callbacks — filtered to this link only (BT_CONN_ROLE_CENTRAL);
 * the HID / raw-IMU peripheral links are handled by main.c's own callback.
 * ============================================================ */

static void central_connected(struct bt_conn* conn, uint8_t err) {
    struct bt_conn_info info;
    bt_conn_get_info(conn, &info);
    if (info.role != BT_CONN_ROLE_CENTRAL) {
        return;
    }

    if (err) {
        DBG_PRINTK("CENTRAL: connect failed (%u)\n", err);
        bt_conn_unref(esp32_conn);
        esp32_conn = NULL;
        start_scan();
        return;
    }

    DBG_PRINTK("CENTRAL: connected to ESP32\n");
    start_discovery(conn);
}

static void central_disconnected(struct bt_conn* conn, uint8_t reason) {
    struct bt_conn_info info;
    bt_conn_get_info(conn, &info);
    if (info.role != BT_CONN_ROLE_CENTRAL || conn != esp32_conn) {
        return;
    }

    DBG_PRINTK("CENTRAL: disconnected from ESP32 (reason 0x%02x)\n", reason);
    bt_conn_unref(esp32_conn);
    esp32_conn = NULL;
    start_scan();
}

BT_CONN_CB_DEFINE(central_conn_callbacks) = {
    .connected = central_connected,
    .disconnected = central_disconnected,
};

/* ============================================================
 * Init
 * ============================================================ */

void ble_central_init(void) {
    for (size_t i = 0; i < ARRAY_SIZE(cmd_leds); i++) {
        if (!gpio_is_ready_dt(&cmd_leds[i])) {
            DBG_PRINTK("CENTRAL: LED%u not ready\n", (unsigned)(i + 1));
            continue;
        }
        gpio_pin_configure_dt(&cmd_leds[i], GPIO_OUTPUT_INACTIVE);
    }

    start_scan();
}

#endif /* ENABLE_NRF53_AS_CENTRAL */
```

## src/ble_central.h
```c
/*
 * ble_central.h — nRF53 acting as a BLE Central, connected to an ESP32
 * peripheral. See ble_central.c for the service/characteristic UUIDs,
 * command set, and LED mapping.
 */

#ifndef BLE_CENTRAL_H
#define BLE_CENTRAL_H

/*
 * Configures the command LEDs and starts scanning for the ESP32 peripheral.
 * Call once after bt_enable() / settings_load().
 */
void ble_central_init(void);

#endif /* BLE_CENTRAL_H */
```

## src/ble_hid.c
```c
/*
 * ble_hid.c — BLE HID mouse profile (identity 0, "Virtual Mouse")
 */

#include <stdbool.h>

#include "app_config.h"

#ifdef ENABLE_BLE_HID

#include <bluetooth/services/hids.h>
#include <zephyr/bluetooth/bluetooth.h>
#include <zephyr/bluetooth/conn.h>
#include <zephyr/bluetooth/uuid.h>
#include <zephyr/kernel.h>
#include <zephyr/logging/log.h>
#include <zephyr/sys/printk.h>

#include "ble_hid.h"
#include "imu_mouse.h"

LOG_MODULE_REGISTER(ble_hid, LOG_LEVEL_INF);

#define MOUSE_REP_SIZE 3
#define MOUSE_REP_IDX  0

BT_HIDS_DEF(hids_obj, MOUSE_REP_SIZE);

static struct bt_conn* current_conn;
static bool            s_active;

/*
 * HID report descriptor — 3-byte relative mouse.
 * Byte 0: buttons (3 bits) + padding (5 bits)
 * Byte 1: X movement, signed, -127 to +127
 * Byte 2: Y movement, signed, -127 to +127
 */
static const uint8_t report_map[] = {
    0x05, 0x01, /* Usage Page (Generic Desktop)       */
    0x09, 0x02, /* Usage (Mouse)                      */
    0xA1, 0x01, /* Collection (Application)           */
    0x09, 0x01, /*   Usage (Pointer)                  */
    0xA1, 0x00, /*   Collection (Physical)            */
    0x05, 0x09, /*     Usage Page (Buttons)           */
    0x19, 0x01, /*     Usage Minimum (1)              */
    0x29, 0x03, /*     Usage Maximum (3)              */
    0x15, 0x00, /*     Logical Minimum (0)            */
    0x25, 0x01, /*     Logical Maximum (1)            */
    0x75, 0x01, /*     Report Size (1 bit)            */
    0x95, 0x03, /*     Report Count (3 buttons)       */
    0x81, 0x02, /*     Input (Data, Variable, Abs)    */
    0x75, 0x05, /*     Report Size (5 bits padding)   */
    0x95, 0x01, /*     Report Count (1)               */
    0x81, 0x01, /*     Input (Constant)               */
    0x05, 0x01, /*     Usage Page (Generic Desktop)   */
    0x09, 0x30, /*     Usage (X)                      */
    0x09, 0x31, /*     Usage (Y)                      */
    0x15, 0x81, /*     Logical Minimum (-127)         */
    0x25, 0x7F, /*     Logical Maximum (+127)         */
    0x75, 0x08, /*     Report Size (8 bits)           */
    0x95, 0x02, /*     Report Count (2 axes)          */
    0x81, 0x06, /*     Input (Data, Variable, Rel)    */
    0xC0,       /*   End Collection                   */
    0xC0,       /* End Collection                     */
};

static const struct bt_data ad_hid[] = {
    BT_DATA_BYTES(BT_DATA_FLAGS, BT_LE_AD_GENERAL | BT_LE_AD_NO_BREDR),
    BT_DATA_BYTES(BT_DATA_UUID16_ALL, BT_UUID_16_ENCODE(BT_UUID_HIDS_VAL)),
};
static const struct bt_data sd_hid[] = {
    BT_DATA(BT_DATA_NAME_COMPLETE, CONFIG_BT_DEVICE_NAME,
            sizeof(CONFIG_BT_DEVICE_NAME) - 1),
};

static struct bt_le_ext_adv* s_adv_hid;

static void start_hid_adv(void) {
    int err = bt_le_ext_adv_start(s_adv_hid, BT_LE_EXT_ADV_START_DEFAULT);
    if (err == 0) {
        DBG_PRINTK("HID_ADV: started\n");
    } else if (err != -EALREADY) {
        DBG_PRINTK("HID_ADV: failed %d\n", err);
    }
}

static void hid_adv_work_fn(struct k_work* work) {
    ARG_UNUSED(work);
    start_hid_adv();
}
K_WORK_DEFINE(s_hid_adv_work, hid_adv_work_fn);

static const struct bt_le_conn_param k_hid_conn_params = {
    .interval_min = 6, /* 7.5 ms */
    .interval_max = 9, /* 11.25 ms */
    .latency = 0,
    .timeout = 400, /* 4 s */
};

static void send_mouse(int8_t x, int8_t y) {
    if (!current_conn) {
        return;
    }
    uint8_t rep[MOUSE_REP_SIZE] = {0, (uint8_t)x, (uint8_t)y};
    bt_hids_inp_rep_send(&hids_obj, current_conn, MOUSE_REP_IDX,
                         rep, sizeof(rep), NULL);
}

static void hids_init(void) {
    struct bt_hids_init_param hids_init = {0};
    struct bt_hids_inp_rep*   inp_rep;

    hids_init.rep_map.data = report_map;
    hids_init.rep_map.size = sizeof(report_map);
    hids_init.info.bcd_hid = 0x0101;
    hids_init.info.b_country_code = 0x00;
    hids_init.info.flags = BT_HIDS_REMOTE_WAKE | BT_HIDS_NORMALLY_CONNECTABLE;

    inp_rep = &hids_init.inp_rep_group_init.reports[0];
    inp_rep->size = MOUSE_REP_SIZE;
    inp_rep->id = 0;
    hids_init.inp_rep_group_init.cnt = 1;
    hids_init.is_mouse = true;

    bt_hids_init(&hids_obj, &hids_init);
}

/* ============================================================
 * Connection callbacks — filtered to this identity only (id 0, peripheral
 * role); the raw-IMU / central links are handled by their own modules.
 * ============================================================ */

static void hid_connected(struct bt_conn* conn, uint8_t err) {
    if (err) {
        return;
    }

    struct bt_conn_info info;
    bt_conn_get_info(conn, &info);
    if (info.id != BT_ID_DEFAULT || info.role != BT_CONN_ROLE_PERIPHERAL) {
        return;
    }

    bt_hids_connected(&hids_obj, conn);
    current_conn = bt_conn_ref(conn);
    bt_conn_set_security(conn, BT_SECURITY_L2);
    bt_conn_le_param_update(conn, &k_hid_conn_params);
}

static void hid_disconnected(struct bt_conn* conn, uint8_t reason) {
    ARG_UNUSED(reason);

    struct bt_conn_info info;
    bt_conn_get_info(conn, &info);
    if (info.id != BT_ID_DEFAULT || info.role != BT_CONN_ROLE_PERIPHERAL) {
        return;
    }

    bt_hids_disconnected(&hids_obj, conn);
    bt_conn_unref(current_conn);
    current_conn = NULL;

    if (s_active) {
        k_work_submit(&s_hid_adv_work);
    }
}

BT_CONN_CB_DEFINE(hid_conn_callbacks) = {
    .connected = hid_connected,
    .disconnected = hid_disconnected,
};

/* ============================================================
 * Public API
 * ============================================================ */

void ble_hid_init(void) {
    struct bt_le_adv_param p = {
        .id = BT_ID_DEFAULT,
        .sid = 0,
        .secondary_max_skip = 0,
        .options = BT_LE_ADV_OPT_CONNECTABLE,
        .interval_min = BT_GAP_ADV_FAST_INT_MIN_2,
        .interval_max = BT_GAP_ADV_FAST_INT_MAX_2,
        .peer = NULL,
    };
    int err = bt_le_ext_adv_create(&p, NULL, &s_adv_hid);
    if (err) {
        DBG_PRINTK("HID_ADV_CREATE_ERR: %d\n", err);
        return;
    }
    bt_le_ext_adv_set_data(s_adv_hid, ad_hid, ARRAY_SIZE(ad_hid), sd_hid, ARRAY_SIZE(sd_hid));

    hids_init();
    imu_mouse_init(send_mouse);
}

void ble_hid_set_active(bool active) {
    s_active = active;
    imu_mouse_set_enabled(active);

    if (s_adv_hid) {
        bt_le_ext_adv_stop(s_adv_hid);
    }
    if (s_adv_hid && active) {
        start_hid_adv();
    }
}

#else /* ENABLE_BLE_HID not defined — provide no-op stubs */

void ble_hid_init(void) {
}
void ble_hid_set_active(bool a) {
    (void)a;
}

#endif /* ENABLE_BLE_HID */
```

## src/ble_hid.h
```c
/*
 * ble_hid.h — BLE HID mouse profile (identity 0, "Virtual Mouse")
 *
 * Advertises and exposes a standard HID-over-GATT mouse. See ble_hid.c for
 * the report descriptor and advertising data.
 */

#ifndef BLE_HID_H
#define BLE_HID_H

#include <stdbool.h>

/*
 * Creates the HID adv set, initialises the HIDS GATT service, and wires up
 * imu_mouse.c's output callback. Does not start advertising. Call once
 * after bt_enable() / settings_load().
 */
void ble_hid_init(void);

/*
 * Enable or disable the HID mouse at runtime: starts/stops advertising and
 * enables/disables imu_mouse.c's motion output.
 */
void ble_hid_set_active(bool active);

#endif /* BLE_HID_H */
```

## src/ble_raw_data.c
```c
/*
 * ble_raw_data.c — "IMU Raw Data" BLE GATT notify service (optional)
 *
 * Architecture:
 *   IMU callback → queue (never touches BLE)
 *   k_work_delayable drains queue → bt_gatt_notify
 */

#include <stdbool.h>
#include <string.h>

#include <zephyr/bluetooth/bluetooth.h>
#include <zephyr/bluetooth/conn.h>
#include <zephyr/bluetooth/gatt.h>
#include <zephyr/kernel.h>
#include <zephyr/logging/log.h>

#include "app_config.h"
#include "ble_raw_data.h"
#include "imu.h"

LOG_MODULE_REGISTER(ble_raw_data, LOG_LEVEL_INF);

#ifdef ENABLE_BLE_RAW_DATA

#define BT_UUID_IMU_SVC_VAL \
    BT_UUID_128_ENCODE(0xa0f0e0d0, 0x0001, 0x0000, 0x0000, 0x000000000000ULL)
#define BT_UUID_IMU_RAW_VAL \
    BT_UUID_128_ENCODE(0xa0f0e0d0, 0x0002, 0x0000, 0x0000, 0x000000000000ULL)

static struct bt_uuid_128 imu_svc_uuid = BT_UUID_INIT_128(BT_UUID_IMU_SVC_VAL);
static struct bt_uuid_128 imu_raw_uuid = BT_UUID_INIT_128(BT_UUID_IMU_RAW_VAL);

struct __packed imu_notify_payload {
    uint32_t ts_ticks;
    int16_t  ax, ay, az;
    int16_t  gx, gy, gz;
};

BUILD_ASSERT(sizeof(struct imu_notify_payload) == 16, "IMU notify payload must be 16 bytes");

static bool s_notify_enabled;
static bool s_enabled; /* mode gating; drives both notify output and advertising */

/* ============================================================
 * Advertising — identity 1 ("VM-Raw")
 * ============================================================ */

#define RAW_DEVICE_NAME "VM-Raw"
static const struct bt_data ad_raw[] = {
    BT_DATA_BYTES(BT_DATA_FLAGS, BT_LE_AD_GENERAL | BT_LE_AD_NO_BREDR),
    BT_DATA(BT_DATA_NAME_COMPLETE, RAW_DEVICE_NAME, sizeof(RAW_DEVICE_NAME) - 1),
};

static struct bt_le_ext_adv* s_adv_raw;
static struct bt_conn*       s_raw_conn;

static void start_raw_adv(void) {
    int err = bt_le_ext_adv_start(s_adv_raw, BT_LE_EXT_ADV_START_DEFAULT);
    if (err == 0) {
        DBG_PRINTK("RAW_ADV: started\n");
    } else if (err != -EALREADY) {
        DBG_PRINTK("RAW_ADV: failed %d\n", err);
    }
}

static void raw_adv_work_fn(struct k_work* work) {
    ARG_UNUSED(work);
    start_raw_adv();
}
K_WORK_DEFINE(s_raw_adv_work, raw_adv_work_fn);

static struct k_work_delayable s_raw_param_work;

/* 15–25 ms: smooth IMU streaming while leaving bandwidth for HID. */
static const struct bt_le_conn_param k_raw_conn_params = {
    .interval_min = 12, /* 15 ms */
    .interval_max = 20, /* 25 ms */
    .latency = 0,
    .timeout = 400, /* 4 s */
};

static void raw_param_work_fn(struct k_work* work) {
    ARG_UNUSED(work);
    if (s_raw_conn) {
        bt_conn_le_param_update(s_raw_conn, &k_raw_conn_params);
    }
}

/* ============================================================
 * Connection callbacks — filtered to identity 1 only; the HID / central
 * links are handled by their own modules.
 * ============================================================ */

static void raw_connected(struct bt_conn* conn, uint8_t err) {
    if (err) {
        return;
    }

    struct bt_conn_info info;
    bt_conn_get_info(conn, &info);
    if (info.id != 1) {
        return;
    }

    if (s_raw_conn) {
        bt_conn_unref(s_raw_conn);
    }
    s_raw_conn = bt_conn_ref(conn);
    k_work_schedule(&s_raw_param_work, K_MSEC(500));
}

static void raw_disconnected(struct bt_conn* conn, uint8_t reason) {
    ARG_UNUSED(reason);

    struct bt_conn_info info;
    bt_conn_get_info(conn, &info);
    if (info.id != 1) {
        return;
    }

    k_work_cancel_delayable(&s_raw_param_work);
    bt_conn_unref(s_raw_conn);
    s_raw_conn = NULL;

    if (s_enabled) {
        k_work_submit(&s_raw_adv_work);
    }
}

BT_CONN_CB_DEFINE(raw_conn_callbacks) = {
    .connected = raw_connected,
    .disconnected = raw_disconnected,
};

void ble_raw_data_set_enabled(bool enabled) {
    s_enabled = enabled;
    DBG_PRINTK("STATUS:BLE_RAW:%s\n", enabled ? "on" : "off");

    if (s_adv_raw) {
        bt_le_ext_adv_stop(s_adv_raw);
    }
    if (s_adv_raw && enabled) {
        start_raw_adv();
    }
}

static void imu_ccc_changed(const struct bt_gatt_attr* attr, uint16_t value) {
    ARG_UNUSED(attr);
    s_notify_enabled = (value == BT_GATT_CCC_NOTIFY);
    DBG_PRINTK("STATUS:BLE_RAW_CLIENT:%s\n", s_notify_enabled ? "subscribed" : "unsubscribed");
}

BT_GATT_SERVICE_DEFINE(imu_svc,
                       BT_GATT_PRIMARY_SERVICE(&imu_svc_uuid),
                       BT_GATT_CHARACTERISTIC(&imu_raw_uuid.uuid,
                                              BT_GATT_CHRC_NOTIFY,
                                              BT_GATT_PERM_NONE,
                                              NULL, NULL, NULL),
                       BT_GATT_CCC(imu_ccc_changed, BT_GATT_PERM_READ | BT_GATT_PERM_WRITE),
                       BT_GATT_CUD("IMU Raw Data", BT_GATT_PERM_READ), );

/* ---- Queue ---- */

#define QUEUE_CAP  256u /* ~5 s at 52 Hz; power-of-2 for fast masking */
#define QUEUE_MASK (QUEUE_CAP - 1u)

static struct imu_notify_payload s_queue[QUEUE_CAP];
static uint32_t                  s_queue_head; /* written by IMU callback only */
static uint32_t                  s_queue_tail; /* read/written by drain work only */

static struct k_work_delayable s_drain_work;

static void drain_work_fn(struct k_work* work) {
    ARG_UNUSED(work);

    if (s_queue_head == s_queue_tail) {
        return;
    }

    struct imu_notify_payload sample = s_queue[s_queue_tail & QUEUE_MASK];

    int err = bt_gatt_notify(NULL, &imu_svc.attrs[2], &sample, sizeof(sample));
    if (err == 0) {
        s_queue_tail++;
        if (s_queue_head != s_queue_tail) {
            k_work_schedule(&s_drain_work, K_MSEC(10));
        }
    } else if (err == -ENOMEM) {
        k_work_schedule(&s_drain_work, K_MSEC(50));
    }
}

static void on_imu_sample(const struct imu_sample* s) {
    if (!s_enabled || !s_notify_enabled) {
        return;
    }

    /* Drop oldest if queue is full */
    if ((s_queue_head - s_queue_tail) >= QUEUE_CAP) {
        s_queue_tail++;
    }

    s_queue[s_queue_head & QUEUE_MASK] = (struct imu_notify_payload){
        .ts_ticks = s->ts_ticks,
        .ax = s->ax,
        .ay = s->ay,
        .az = s->az,
        .gx = s->gx,
        .gy = s->gy,
        .gz = s->gz,
    };
    s_queue_head++;

    k_work_schedule(&s_drain_work, K_NO_WAIT);
}

void ble_raw_data_init(void) {
    /* Identity 1 ("VM-Raw") — created once, address persisted to NVS.
     * Returns -ENOMEM when already at CONFIG_BT_ID_MAX after settings_load(). */
    int id = bt_id_create(NULL, NULL);
    if (id < 0 && id != -ENOMEM) {
        DBG_PRINTK("RAW_ID_CREATE_ERR: %d\n", id);
    }

    struct bt_le_adv_param p = {
        .id = 1,
        .sid = 0,
        .secondary_max_skip = 0,
        .options = BT_LE_ADV_OPT_CONNECTABLE,
        .interval_min = BT_GAP_ADV_FAST_INT_MIN_2,
        .interval_max = BT_GAP_ADV_FAST_INT_MAX_2,
        .peer = NULL,
    };
    int err = bt_le_ext_adv_create(&p, NULL, &s_adv_raw);
    if (err) {
        DBG_PRINTK("RAW_ADV_CREATE_ERR: %d\n", err);
        return;
    }
    bt_le_ext_adv_set_data(s_adv_raw, ad_raw, ARRAY_SIZE(ad_raw), NULL, 0);

    k_work_init_delayable(&s_raw_param_work, raw_param_work_fn);
    k_work_init_delayable(&s_drain_work, drain_work_fn);
    imu_add_sample_cb(on_imu_sample);
    LOG_INF("IMU_RAW_DATA service ready");
}

#else /* ENABLE_BLE_RAW_DATA not defined — provide no-op stubs */

void ble_raw_data_init(void) {
}
void ble_raw_data_set_enabled(bool e) {
    (void)e;
}

#endif /* ENABLE_BLE_RAW_DATA */
```

## src/ble_raw_data.h
```c
/*
 * ble_raw_data.h — BLE GATT service that streams raw IMU samples
 *
 * Exposes a custom notify characteristic ("IMU Raw Data") carrying the
 * same timestamp + accel + gyro fields as the UART CSV output. See
 * ble_raw_data.c for the wire format and UUIDs.
 */

#ifndef BLE_RAW_DATA_H
#define BLE_RAW_DATA_H

#include <stdbool.h>

/*
 * Subscribes to imu.c's sample callback so every IMU sample is forwarded
 * as a BLE notification. Call once after bt_enable() / settings_load().
 */
void ble_raw_data_init(void);

/*
 * Enable or disable BLE raw data notifications at runtime.
 * When disabled, on_imu_sample() returns immediately (no BLE TX).
 * Enabled state is independent of whether a client has subscribed.
 */
void ble_raw_data_set_enabled(bool enabled);

#endif /* BLE_RAW_DATA_H */
```

## src/imu.h
```c
/*
 * imu.h — LSM6DSO IMU interface
 *
 * Two threads are defined in imu.c and start automatically:
 *   imu_tid  — drains the FIFO, prints CSV to UART, fires the sample callback
 *   cmd_tid  — reads UART for RATE:1..RATE:5 commands
 *
 * CSV output format (one line per complete accel+gyro+timestamp set):
 *   timestamp,ax,ay,az,gx,gy,gz
 *
 * All sensor values are raw int16 straight from the LSM6DSO registers.
 * Apply these scale factors in post-processing:
 *
 *   timestamp : 25 µs per tick  →  tick × 0.025 = ms,  tick × 0.000025 = s
 *   ax/ay/az  : accel raw → × 0.061  = milli-g   (±2 g range)
 *   gx/gy/gz  : gyro  raw → × 0.0175 = dps       (±500 dps range)
 *
 * UART commands (ASCII, terminated with \n or \r):
 *   RATE:1 → 12.5 Hz
 *   RATE:2 → 26   Hz
 *   RATE:3 → 52   Hz
 *   RATE:4 → 104  Hz
 *   RATE:5 → 208  Hz
 *   MODE:0 → UART raw CSV (no BLE)
 *   MODE:1 → BLE HID mouse only
 *   MODE:2 → BLE raw IMU stream only
 *   MODE:3 → BLE HID + raw IMU stream
 */

#ifndef IMU_H
#define IMU_H

#include <stdbool.h>
#include <stdint.h>

/* One complete IMU sample produced by imu.c — same fields as the CSV row. */
struct imu_sample {
    uint32_t ts_ticks; /* hardware timestamp, 25 µs per tick */
    int16_t  ax, ay, az;
    int16_t  gx, gy, gz;
};

/*
 * Register a callback to receive every sample as it is emitted.
 * Called from the IMU thread — keep the handler non-blocking.
 * Pass NULL to deregister.  Consumers (e.g. ble_raw_data.c) call this once
 * at init; imu.c has no knowledge of who is listening.
 */
typedef void (*imu_sample_cb_t)(const struct imu_sample* s);

/* Register a callback in the next free slot (up to 4 total).
 * Returns 0 on success, -ENOMEM if all slots are full. */
int imu_add_sample_cb(imu_sample_cb_t cb);

/* Enable or disable the UART CSV raw-data stream (MODE:1). */
void imu_set_uart_raw(bool enabled);

/*
 * Register a callback invoked whenever a MODE:N command arrives.
 * The callback receives the new mode integer (1–4).  Called from the
 * cmd thread — the handler must be non-blocking.
 */
void imu_set_mode_change_cb(void (*cb)(int mode));

#endif /* IMU_H */
```

## src/imu_mouse.h
```c
/*
 * imu_mouse.h — IMU-to-mouse-delta processor
 *
 * Two-stage pipeline:
 *   Stage 1 — Sensor fusion: gyro bias calibration + mounting detection +
 *             updateQuaternionGRV (Game Rotation Vector: gradient-descent
 *             accel+gyro fusion) → Euler angles (yaw, pitch). Internal
 *             variable names in imu_mouse.c follow the GRV section of the
 *             author's own fusion.c (SensorFusion/) for cross-reference.
 *   Stage 2 — Mouse delta: rate-independent EMA smoothing → angular delta
 *             → deadzone gate → sensitivity → int8 HID output with sub-pixel
 *             accumulation.
 *
 * Usage:
 *   imu_mouse_init(send_mouse);   // call once after bt_enable(); self-registers callback
 */

#ifndef IMU_MOUSE_H
#define IMU_MOUSE_H

#include <stdbool.h>
#include <stdint.h>

/*
 * Output callback type: called with (dx, dy) whenever motion is detected.
 * Signature matches send_mouse() in main.c so it can be passed directly.
 */
typedef void (*mouse_output_cb_t)(int8_t dx, int8_t dy);

/*
 * Initialise all internal state and register output_cb as the mouse report
 * sink.  Must be called once; self-registers with imu_add_sample_cb().
 */
void imu_mouse_init(mouse_output_cb_t output_cb);

/*
 * Enable or disable the mouse pipeline at runtime.
 *
 * Disabling stops GRV processing and suppresses HID reports immediately.
 * Re-enabling triggers a fresh calibration cycle (settle + collect), so the
 * cursor is ready once calibration completes (~6 s at default settings).
 */
void imu_mouse_set_enabled(bool enabled);

#endif /* IMU_MOUSE_H */
```
